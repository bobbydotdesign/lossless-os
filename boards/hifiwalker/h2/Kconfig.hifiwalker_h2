## boards/hifiwalker/h2/Kconfig.hifiwalker_h2
```kconfig
# SPDX-License-Identifier: Apache-2.0

config BOARD_HIFIWALKER_H2
	select SOC_X1000
```

## boards/hifiwalker/h2/board.yml
```yaml
board:
  name: hifiwalker_h2
  full_name: HiFi Walker H2
  vendor: hifiwalker
  socs:
  - name: x1000
```

## drivers/Kconfig
```kconfig
# Lossless OS drivers for the X1000 (out of Zephyr's tree)
# SPDX-License-Identifier: Apache-2.0

config SDHC_X1000
	bool "Ingenic X1000 MSC SD host controller"
	default y
	depends on DT_HAS_INGENIC_X1000_MSC_ENABLED
	depends on SDHC
	select SDHC_SUPPORTS_NATIVE_MODE

config DISPLAY_HANDOVER_FB
	bool "Screen handed over by the bootloader"
	default y
	depends on DT_HAS_LOSSLESS_HANDOVER_FRAMEBUFFER_ENABLED
	depends on DISPLAY
```

## dts/bindings/display/lossless,handover-framebuffer.yaml
```yaml
# SPDX-License-Identifier: Apache-2.0

description: |
  A screen the bootloader left running: the LCD controller keeps sending a
  frame from memory to the panel, and the driver draws into that frame.
  Found at start-up by following the controller's DMA descriptors.

compatible: "lossless,handover-framebuffer"

include: display-controller.yaml

properties:
  reg:
    required: true
    description: The LCD controller's registers
```

## dts/bindings/sdhc/ingenic,x1000-msc.yaml
```yaml
# SPDX-License-Identifier: Apache-2.0

description: Ingenic X1000 MSC, the SD/MMC host controller

compatible: "ingenic,x1000-msc"

include: [sdhc.yaml]

properties:
  reg:
    required: true
```

## soc/ingenic/x1000/Kconfig
```kconfig
# SPDX-License-Identifier: Apache-2.0

config SOC_X1000
	select MIPS

rsource "../../../drivers/Kconfig"
```
